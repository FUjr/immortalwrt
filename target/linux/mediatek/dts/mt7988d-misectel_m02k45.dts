// SPDX-License-Identifier: GPL-2.0-or-later OR MIT
/*
 * Copyright (C) 2025 Tianling Shen <cnsztl@immortalwrt.org>
 */

/dts-v1/;
#include "mt7988d-misectel_m02k45-common.dtsi"

#include "mt7988d-misectel-m02-spim-nand.dtsi"
